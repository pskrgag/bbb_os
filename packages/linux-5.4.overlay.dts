/dts-v1/;
/plugin/;

/ {
	fragment@0 {
		target = <&pcdev0>;
	
		__overlay__ {
			status = "disabled";
		};
	};

	fragment@1 {
		target = <&pcdev1>;
	
		__overlay__ {
			status = "disabled";
		};
	};

	fragment@2 {
		target = <&pcdev2>;
	
		__overlay__ {
			pskrgag,size = <12345>;
		};
	};
};